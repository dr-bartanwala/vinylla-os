## opt/pi0w/Config.in
```kconfig
source "$BR2_EXTERNAL_RPI0W_Vinylla_PATH/../vinylla-applications/hello-world/Config.in"
```

## opt/pi0w/configs/pi0w_defconfig
```kconfig
BR2_arm=y
BR2_arm1176jzf_s=y
BR2_TOOLCHAIN_BUILDROOT_VENDOR="Buildroot"
BR2_PACKAGE_HOST_LINUX_HEADERS_CUSTOM_5_15=y
BR2_PACKAGE_GLIBC_UTILS=y
BR2_TOOLCHAIN_BUILDROOT_CXX=y
BR2_DL_DIR="$(TOPDIR)/../../buildroot_dl"
BR2_CCACHE=y
BR2_REPRODUCIBLE=y
BR2_TARGET_GENERIC_HOSTNAME="viynlla-os"
BR2_ROOTFS_DEVICE_CREATION_DYNAMIC_MDEV=y
BR2_TARGET_GENERIC_ROOT_PASSWD="12345"
BR2_ROOTFS_OVERLAY="../rootfs-overlay/"
BR2_ROOTFS_POST_BUILD_SCRIPT="../pi0/board/post-build.sh"
BR2_ROOTFS_POST_IMAGE_SCRIPT="../pi0/board/post-image-vinylla.sh"
BR2_LINUX_KERNEL=y
BR2_LINUX_KERNEL_CUSTOM_TARBALL=y
BR2_LINUX_KERNEL_CUSTOM_TARBALL_LOCATION="$(call github,raspberrypi,linux,21b410140c47ffab5668399f6f143c7d7b935c8b)/linux-21b410140c47ffab5668399f6f143c7d7b935c8b.tar.gz"
# will be using the default kernel config for now
BR2_LINUX_KERNEL_DEFCONFIG="bcmrpi"
BR2_LINUX_KERNEL_DTS_SUPPORT=y
BR2_LINUX_KERNEL_INTREE_DTS_NAME="broadcom/bcm2708-rpi-zero-w"
BR2_LINUX_KERNEL_NEEDS_HOST_OPENSSL=y
BR2_PACKAGE_BUSYBOX_SHOW_OTHERS=y
BR2_PACKAGE_RPI_FIRMWARE=y
BR2_PACKAGE_RPI_FIRMWARE_BOOTCODE_BIN=y
BR2_PACKAGE_RPI_FIRMWARE_VARIANT_PI=y
BR2_PACKAGE_RPI_FIRMWARE_CONFIG_FILE="../pi0/board/boot_config.txt"
BR2_PACKAGE_RPI_FIRMWARE_CMDLINE_FILE="../pi0/board/boot_cmdline.txt"
BR2_TARGET_ROOTFS_CPIO_GZIP=y
BR2_TARGET_ROOTFS_INITRAMFS=y
BR2_PACKAGE_HOST_DOSFSTOOLS=y
BR2_PACKAGE_HOST_E2FSPROGS=y
BR2_PACKAGE_HOST_GENIMAGE=y
BR2_PACKAGE_HOST_KMOD_XZ=y
BR2_PACKAGE_HOST_MTOOLS=y
```

## opt/vinylla-applications/hello-world/Config.in
```kconfig
config BR2_PACKAGE_HELLO_WORLD
    bool "hello-world"
    help
      Hello world application for Vinylla.
```
